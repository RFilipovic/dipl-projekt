## build/conf/bblayers.conf
```bitbake
# POKY_BBLAYERS_CONF_VERSION is increased each time build/conf/bblayers.conf
# changes incompatibly
POKY_BBLAYERS_CONF_VERSION = "2"

BBPATH = "${TOPDIR}"
BBFILES ?= ""

BBLAYERS ?= " \
  /home/rene/Documents/projekt-dipl/dipl-projekt/meta \
  /home/rene/Documents/projekt-dipl/dipl-projekt/meta-poky \
  /home/rene/Documents/projekt-dipl/dipl-projekt/meta-yocto-bsp \
  /home/rene/Documents/projekt-dipl/dipl-projekt/meta-diplomski \
  /home/rene/Documents/projekt-dipl/dipl-projekt/meta-openembedded/meta-oe \
  /home/rene/Documents/projekt-dipl/dipl-projekt/meta-openembedded/meta-python \
  /home/rene/Documents/projekt-dipl/dipl-projekt/meta-openembedded/meta-networking \
  "
```

## meta-diplomski/conf/layer.conf
```bitbake
# We have a conf and classes directory, add to BBPATH
BBPATH .= ":${LAYERDIR}"

# We have recipes-* directories, add to BBFILES
BBFILES += "${LAYERDIR}/recipes-*/*/*.bb \
            ${LAYERDIR}/recipes-*/*/*.bbappend"

BBFILE_COLLECTIONS += "meta-diplomski"
BBFILE_PATTERN_meta-diplomski = "^${LAYERDIR}/"
BBFILE_PRIORITY_meta-diplomski = "6"

LAYERDEPENDS_meta-diplomski = "core"
LAYERSERIES_COMPAT_meta-diplomski = "scarthgap"
```
